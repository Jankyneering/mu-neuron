## board/universal/packages/python-luma-core/Config.in
```kconfig
# board/universal/packages/python-luma-core/Config.in
config BR2_PACKAGE_PYTHON_LUMA_CORE
    bool "python-luma-core"
    depends on BR2_PACKAGE_PYTHON3
    help
      Core display library for luma drivers.
```

## board/universal/packages/python-luma-oled/Config.in
```kconfig
# board/universal/packages/python-luma-oled/Config.in
config BR2_PACKAGE_PYTHON_LUMA_OLED
    bool "python-luma-oled"
    depends on BR2_PACKAGE_PYTHON3
    help
      OLED display driver library.
```
