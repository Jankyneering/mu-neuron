## Config.in
```kconfig
# Config.in
source "$BR2_EXTERNAL_MU_NEURON_PATH/board/universal/packages/python-luma-core/Config.in"
source "$BR2_EXTERNAL_MU_NEURON_PATH/board/universal/packages/python-luma-oled/Config.in"
source "$BR2_EXTERNAL_MU_NEURON_PATH/board/universal/packages/soapy-mu-cell/Config.in"
source "$BR2_EXTERNAL_MU_NEURON_PATH/board/universal/packages/mu-cell-bb-dts/Config.in"
```

## board/universal/packages/mu-cell-bb-dts/Config.in
```kconfig
config BR2_PACKAGE_MU_CELL_BB_DTS
    bool "mu-cell-bb-dts"
    help
      Compiles and installs the Device Tree overlay for the µCell BB
      HAT into /boot/overlays/mu-cell-bb_raspberrypi.dtbo.

      The RPi bootloader loads this overlay either because config.txt
      contains  dtoverlay=mu-cell-bb_raspberrypi  or because the HAT
      EEPROM's dt_blob field names it (automatic HAT detection).

      Source: https://github.com/Jankyneering/mu-cell-bb-drivers
```

## board/universal/packages/soapy-mu-cell/Config.in
```kconfig
config BR2_PACKAGE_SOAPY_MU_CELL
    bool "soapy-mu-cell"
    depends on BR2_PACKAGE_SOAPY_SDR
    depends on BR2_PACKAGE_OPENSSL
    depends on BR2_INSTALL_LIBSTDCPP
    depends on BR2_TOOLCHAIN_HAS_THREADS
    help
      SoapySDR driver plugin for the µCell BB HAT (SX1255-based
      baseband board). Builds the SoapyMuCell shared module and
      installs it into SoapySDR's module search path so that
      SoapySDRUtil --find and Python/C++ SoapySDR bindings can
      discover the µCell device at runtime.

      Source: https://github.com/Jankyneering/mu-cell-bb-drivers
```

## board/universal/packages/tetra-bluestation/Config.in
```kconfig
config BR2_PACKAGE_TETRA_BLUESTATION
	bool "tetra-bluestation"
	depends on BR2_PACKAGE_HOST_RUSTC_TARGET_ARCH_SUPPORTS
	select BR2_PACKAGE_HOST_RUSTC
	select BR2_PACKAGE_SOAPY_SDR
	help
	  TETRA base station stack (bluestation-bs) for the µCell BB,
	  built from source against the image's own SoapySDR.
	  https://github.com/MidnightBlueLabs/tetra-bluestation
```
